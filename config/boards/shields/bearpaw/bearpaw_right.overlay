#include "bearpaw.dtsi"

&default_transform {
    col-offset = <6>;
};

&kscan0 {
    col-gpios
        = <&pro_micro 2 GPIO_ACTIVE_HIGH>
        , <&pro_micro 26 GPIO_ACTIVE_HIGH>  // P1.15 → 26 on ProMicro
        , <&pro_micro 23 GPIO_ACTIVE_HIGH>  // P1.13 → 23 on ProMicro
        , <&pro_micro 22 GPIO_ACTIVE_HIGH>  // P1.11 → 22 on ProMicro
        , <&pro_micro 10 GPIO_ACTIVE_HIGH>
        , <&pro_micro 9 GPIO_ACTIVE_HIGH>
        ;
};

