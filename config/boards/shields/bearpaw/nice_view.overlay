/*
 * Copyright (c) 2023 The ZMK Contributors
 *
 * SPDX-License-Identifier: MIT
 */

/ {
    chosen {
        zephyr,display = &nice_view;
    };

    nice_view: nice_view {
        compatible = "nice,view";
        status = "okay";
    };
};

&nice_view_spi {
    cs-gpios = <&pro_micro 4 GPIO_ACTIVE_HIGH>;
};