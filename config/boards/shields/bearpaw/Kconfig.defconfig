## config/boards/shields/bearpaw/Kconfig.defconfig
```kconfig
if SHIELD_BEARPAW_LEFT

config ZMK_KEYBOARD_NAME
    default "Bearpaw"

config ZMK_SPLIT_ROLE_CENTRAL
    default y

config ZMK_USB
    default y

endif # SHIELD_BEARPAW_LEFT

if SHIELD_BEARPAW_LEFT || SHIELD_BEARPAW_RIGHT

config ZMK_SPLIT
    default y

endif # SHIELD_BEARPAW_LEFT || SHIELD_BEARPAW_RIGHT

if ZMK_DISPLAY

config I2C
    default y

config SSD1306
    default y

endif # ZMK_DISPLAY

if LVGL

config LV_Z_VDB_SIZE
    default 64

config LV_DPI_DEF
    default 148

config LV_Z_BITS_PER_PIXEL
    default 1

choice LV_COLOR_DEPTH
    default LV_COLOR_DEPTH_1
endchoice

endif # LVGL
```

## config/boards/shields/bearpaw/Kconfig.shield
```kconfig
config SHIELD_BEARPAW_LEFT
	def_bool $(shields_list_contains,bearpaw_left)

config SHIELD_BEARPAW_RIGHT
	def_bool $(shields_list_contains,bearpaw_right)

config SHIELD_NICE_VIEW
    def_bool $(shields_list_contains,nice_view)
```

## config/west.yml
```yaml
manifest:
  remotes:
    - name: zmkfirmware
      url-base: https://github.com/zmkfirmware
    - name: juliencm-dev #new entry
      url-base: https://github.com/juliencm-dev/ #new entry
    # Additional modules containing boards/shields/custom code can be listed here as well
    # See https://docs.zephyrproject.org/3.2.0/develop/west/manifest.html#projects
  projects:
    - name: zmk
      remote: zmkfirmware
      revision: main
      import: app/west.yml
    - name: nice-view-mod #new entry
      remote: juliencm-dev #new entry
      revision: main #new entry
  self:
    path: config
```
