#include "bearpaw.dtsi"

&kscan0 {
    col-gpios
        = <&pro_micro 9 GPIO_ACTIVE_HIGH>
        , <&pro_micro 21 GPIO_ACTIVE_HIGH>  // P1.10 → 21 on ProMicro
        , <&pro_micro 22 GPIO_ACTIVE_HIGH>  // P1.11 → 22 on ProMicro
        , <&pro_micro 23 GPIO_ACTIVE_HIGH>  // P1.13 → 23 on ProMicro
        , <&pro_micro 15 GPIO_ACTIVE_HIGH>
        , <&pro_micro 2 GPIO_ACTIVE_HIGH>
        ;
};